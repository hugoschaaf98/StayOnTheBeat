## metronome-core/main/Kconfig.projbuild
```kconfig
menu "Metronome Configuration"

    # AUDIO CONFIGURATION
    menu "Audio configuration"
        config M_SAMPLE_RATE
            int "Audio output sample rate"
            default 44100
            help
                choose the same sampling rate as the audio files you want the metronome to read.
    endmenu

    # WIFI CONFIGURATION
    menu "Wifi configuration"
        config M_WIFI_SSID
            string "WiFi SSID"
            default "StayOnTheBeat"
            help
                SSID (network name) for the metronome to connect to.

        config M_WIFI_PASSWORD
            string "WiFi Password"
            default "toBeatOrNotToBeat"
            help
                WiFi password (WPA or WPA2).

        config M_WIFI_MAX_STA_CONN
            int "Maximal STA connections"
            default 1
            help
                Max number of wifi connections.

        config M_MDNS_HOST_NAME
            string "Metronome mDNS Host Name"
            default "stayonthebeat"
            help
                Specify the domain name used in the mDNS service.
                Note that a webpage also take it as a part of URL where it will send GET/POST requests to
    endmenu

    # Data DEPLOY CONFIGURATION
    choice
        prompt "Data deploy mode"
        default M_DATA_DEPLOY_SF
        help
            Select data deploy mode.
            You can deploy data to host, and ESP32 will retrieve them in a semihost way (JTAG is needed).
            You can deploy data to SD card or SPI flash, and ESP32 will retrieve them via SDIO/SPI interface.
            Detailed operation steps are listed in the example README file.
        config M_DATA_DEPLOY_SEMIHOST
            bool "Deploy data to host (JTAG is needed)"
            help
                Deploy data to host.
                It is recommended to choose this mode during developing.
        config M_DATA_DEPLOY_SD
            depends on IDF_TARGET_ESP32
            bool "Deploy data to SD card"
            help
                Deploy data to SD card.
                Choose this production mode if the size of data is too large (bigger than 2MB).
        config M_DATA_DEPLOY_SF
            bool "Deploy data to SPI Nor Flash"
            help
                Deploy data to SPI Nor Flash.
                Choose this production mode if the size of data is small (less than 2MB).
    endchoice

if M_DATA_DEPLOY_SEMIHOST
    config M_HOST_PATH_TO_MOUNT
        string "Host path to mount (e.g. absolute path to data directory)"
        default "PATH-TO-DATA-DIR"
        help
            When using semihost in ESP32, you should specify the host path which will be mounted to VFS.
            Note that only absolute path is acceptable.
endif
    config M_DATA_MOUNT_POINT
        string "data mount point in VFS"
        default "/data"
        help
            Specify the mount point in VFS.
endmenu
```
